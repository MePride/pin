## firmware/sdkconfig.defaults
```kconfig
# Pin Device Default Configuration

# Target ESP32-C3
CONFIG_IDF_TARGET="esp32c3"

# Firmware Version
CONFIG_PIN_FIRMWARE_VERSION="1.0.0"

# Serial Console Configuration
CONFIG_ESPTOOLPY_MONITOR_BAUD_115200B=y
CONFIG_ESPTOOLPY_MONITOR_BAUD=115200

# WiFi Configuration
CONFIG_ESP32_WIFI_AMPDU_TX_ENABLED=n
CONFIG_ESP32_WIFI_AMPDU_RX_ENABLED=n

# Partition Table
CONFIG_PARTITION_TABLE_CUSTOM=y
CONFIG_PARTITION_TABLE_CUSTOM_FILENAME="partitions.csv"

# SPIFFS Configuration
CONFIG_SPIFFS_MAX_PARTITIONS=3

# HTTP Server
CONFIG_HTTPD_MAX_REQ_HDR_LEN=1024
CONFIG_HTTPD_MAX_URI_LEN=512

# mbedTLS
CONFIG_MBEDTLS_HARDWARE_AES=y

# FreeRTOS
CONFIG_FREERTOS_HZ=1000

# ESP32C3-Specific
CONFIG_ESP32C3_LIGHTSLEEP_GPIO_RESET_WORKAROUND=y

# Power Management
CONFIG_PM_ENABLE=y

# Log Level
CONFIG_LOG_DEFAULT_LEVEL_INFO=y
CONFIG_LOG_DEFAULT_LEVEL=3

# NVS
CONFIG_NVS_ENCRYPTION=y

# GPIO Configuration
CONFIG_PIN_DISPLAY_SCK_GPIO=2
CONFIG_PIN_DISPLAY_MOSI_GPIO=3
CONFIG_PIN_DISPLAY_CS_GPIO=10
CONFIG_PIN_DISPLAY_DC_GPIO=4
CONFIG_PIN_DISPLAY_RST_GPIO=5
CONFIG_PIN_DISPLAY_BUSY_GPIO=6

# Battery Monitor
CONFIG_PIN_BATTERY_ADC_CHANNEL=0

# WiFi AP Configuration
CONFIG_PIN_AP_SSID_PREFIX="Pin-Device"
CONFIG_PIN_AP_PASSWORD=""
CONFIG_PIN_AP_CHANNEL=1
CONFIG_PIN_AP_MAX_CONNECTIONS=4

# Plugin System
CONFIG_PIN_MAX_PLUGINS=8
CONFIG_PIN_PLUGIN_DEFAULT_MEMORY_LIMIT=65536
CONFIG_PIN_PLUGIN_API_RATE_LIMIT=100

# Display Configuration
CONFIG_PIN_DISPLAY_WIDTH=600
CONFIG_PIN_DISPLAY_HEIGHT=448
CONFIG_PIN_DISPLAY_COLORS=7
```
